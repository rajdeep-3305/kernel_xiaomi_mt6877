## drivers/gpu/drm/mediatek/Kconfig
```kconfig
# SPDX-License-Identifier: GPL-2.0-only
config DRM_MEDIATEK
	tristate "DRM Support for Mediatek SoCs"
	depends on DRM
	depends on COMMON_CLK
	depends on HAVE_ARM_SMCCC
	depends on OF
	select DRM_GEM_DMA_HELPER
	select DRM_KMS_HELPER
	select DRM_MIPI_DSI
	select DRM_PANEL
	select MEMORY
	select MTK_SMI
        select FONT_SUPPORT
	select GENERIC_PHY
	help
	  Choose this option if you have a Mediatek SoCs.
	  The module will be called mediatek-drm
	  This driver provides kernel mode setting and
	  buffer management to userspace.

config DRM_MEDIATEK_DP
	tristate "DRM DPTX Support for MediaTek SoCs"
	depends on DRM_MEDIATEK
	select DRM_DISPLAY_HELPER
	select DRM_DISPLAY_DP_HELPER
	select DRM_DP_AUX_BUS
	help
	  DRM/KMS Display Port driver for MediaTek SoCs.

config DRM_MEDIATEK_HDMI
	tristate "DRM HDMI Support for Mediatek SoCs"
	depends on DRM_MEDIATEK
	select SND_SOC_HDMI_CODEC if SND_SOC
	select GENERIC_PHY
	help
	  DRM/KMS HDMI driver for Mediatek SoCs

config MTK_DISP_NO_LK
	bool "Reinitialize the MediaTek display pipeline"
	depends on DRM_MEDIATEK
	help
	  Ignore the bootloader framebuffer handoff and initialize the display
	  controller, DSI host, clocks, and PHY from a known state. Select this
	  when the bootloader framebuffer tag survives but the display hardware
	  state does not. The first atomic modeset will then configure the whole
	  display pipeline instead of trying to reuse stale hardware state.

config MTK_HDR_COLOR_GAIN_RGB
	hex "Config CCORR parameters for HDR layers"
	default 0
	help
	  This control color gain for hdr screen.
	  0~11 bit for blue gain.
	  12~23 bit for green gain.
	  24~63 bit for red gain.

config MTK_PQ_COLOR_MODE
	string "Config PQ_COLOR_MODE (MDP & DISP COLOR on/off)"
	default "DISP"
	help
	  This control mdp color on/off and disp color on/off
	  if value equals to DISP, only display color is on.
	  if value equals to MDP, only mdp color is on.
	  if value equals to DISP_MDP, mdp and display color are both on.
	  if value equals to OFF, mdp and display color are both off.

config DRM_MTK_SHADOW_REGISTER_SUPPORT
	bool "DRM shadow register Support for Mediatek SoCs"
	depends on DRM_MEDIATEK
	help
	  DRM shadow register Support for Mediatek SoCs.
	  define CONFIG_DRM_MTK_SHADOW_REGISTER_SUPPORT to
	  enable Shadow Register on display.
	  This feature will de-risk configuration time shortage.
	  If you want to use Shadow Register on display,
	  please make sure it is Y in xxx_defconfig.
	  This feature depends on Mediatek SoCs HW spec.
	  If unsure, set N.

config DRM_MTK_DISABLE_AEE_LAYER
	bool "Disable AEE Layer for the customer who don't want to produce AEE"
	help
	  Disable AEE Layer if you do not want to produce AEE.
	  Default Mediatek SoCs will produce AEE when exception occurred.
	  if this value is y, will not produce AEE.
	  if this value is n, will produce AEE.
	  If you do not produce AEE, please set it to Y in xxx_defconfig.

source "drivers/gpu/drm/mediatek/mi_disp/Kconfig"
```

## drivers/media/platform/mtk-vcodec/Kconfig
```kconfig
config VIDEO_MEDIATEK_VCU
	bool "MediaTek legacy Video Communication Unit"
	depends on VIDEO_DEV
	select VIDEOBUF2_DMA_CONTIG
	help
	  Enable the VCU interface used by legacy MediaTek video firmware and
	  userspace daemons.

config VIDEO_MEDIATEK_VCODEC_LEGACY
	bool "MediaTek legacy VCU video codec"
	depends on V4L_MEM2MEM_DRIVERS
	depends on VIDEO_MEDIATEK_VCU
	select MEDIA_CONTROLLER
	select V4L2_MEM2MEM_DEV
	select VIDEOBUF2_DMA_CONTIG
	help
	  Enable the legacy MediaTek encoder and decoder used by vendor VCU
	  firmware and userspace blobs.
```

## drivers/misc/mediatek/cpufreq_v2/Kconfig
```kconfig
config MEDIATEK_CPU_DVFS
	bool "MediaTek CPU DVFS"
	depends on ARCH_MEDIATEK && CPU_FREQ
	help
	  Enable the MediaTek firmware-assisted CPU dynamic voltage and
	  frequency scaling driver.

config MEDIATEK_CPU_DVFS_MT6877
	bool "MediaTek MT6877 CPU DVFS support"
	depends on MEDIATEK_CPU_DVFS && MACH_MT6877
	depends on MTK_TINYSYS_MCUPM_SUPPORT
	help
	  Enable the MT6877 OPP tables and MCUPM interface used by the
	  MediaTek CPU DVFS driver.

config MTK_MT6877_CPU_THERMAL
	bool "MT6877 legacy thermal CPU power-budget enforcement"
	depends on MEDIATEK_CPU_DVFS_MT6877 && MTK_LEGACY_THERMAL
	depends on !MTK_PPM && !MTK_CPU_FREQ
	default y
	help
	  Connect the legacy thermal controller's milliwatt budgets to CPUfreq
	  frequency QoS limits using the MT6877 UPower characterization tables.
	  Account for all possible CPUs without relying on the old HPS hotplug
	  client. Budgets below the all-core minimum saturate at minimum
	  frequency; the thermal shutdown and LVTS hardware reset paths remain
	  necessary. This is not a replacement for temperature calibration.
```

## drivers/misc/mediatek/performance/Kconfig
```kconfig
config MTK_FPSGO_V3
	bool "Support FPSGO_V3 framework"
	depends on CPU_FREQ && UCLAMP_TASK_GROUP
	help
	  Support FPSGO_V3 framework for most FPS performance and
	  low power balance. As a perquisite to ensure FPS performance,
	  FPSGO_V3 persuades lowest power consumption for better DoU
	  endurance and gaming experience.
	  FPSGO_V3 include AI performance and low power.
	  If you are not sure about this, set n.

config MTK_GBE
	bool "MediaTek Game Boost Engine"
	depends on MTK_FPSGO_V3
	help
	  Enable the Game Boost Engine interfaces used by Ruby's stock
	  performance stack.

config MTK_PERF_OBSERVER
	bool "MediaTek performance observer"
	depends on MTK_PERFORMANCE_MODULE
	help
	  Provide the stock Ruby performance notifier interfaces.

config MTK_RESYM
	bool "MediaTek resource symphony"
	depends on MTK_PERF_OBSERVER
	help
	  Provide the stock Ruby resource usage and state interfaces.

config MTK_RUBY_SCHED_PREFER
	bool "Ruby scheduler CPU preference control"
	depends on MTK_PERFORMANCE_MODULE && ARM64 && SMP && UCLAMP_TASK_GROUP && !MTK_SCHED_EXTENSION
	default y if MACH_MT6877
	help
	  Restore Ruby's sched_boost and per-task CPU preference controls
	  during Linux 6.6 fair and real-time task placement. A preference
	  searches the allowed CPU capacity classes in priority order for an
	  idle CPU. It does not change task affinity or CPU frequency limits.

config MTK_RUBY_BIG_TASK_ROTATION
	bool "Ruby big task rotation on Linux 6.6"
	depends on MTK_RUBY_SCHED_PREFER && ANDROID_VENDOR_HOOKS && UCLAMP_TASK_GROUP
	default y if MACH_MT6877
	help
	  Restore Ruby's misfit-task rotation control. When several CPUs
	  have misfit tasks, a slow CPU may exchange its running task with
	  a single running task on a faster CPU after a minimum run time.

config MTK_RUBY_SCHED_LB_ENHANCEMENT
	bool "Ruby same-capacity load balancing with energy scheduling"
	depends on MTK_RUBY_SCHED_PREFER && ENERGY_MODEL
	default y if MACH_MT6877
	help
	  Keep load balancing active between CPUs of the same capacity class
	  when energy-aware scheduling would otherwise skip a balanced domain.

config MTK_RUBY_SCHED_INTEROP
	bool "Ruby real-time and fair scheduler interop"
	depends on MTK_RUBY_SCHED_PREFER && SMP
	default y if MACH_MT6877
	help
	  Prefer an eligible idle CPU for a waking real-time task and avoid
	  charging stale real-time utilization against fair-task capacity.

config MTK_RUBY_IDLE_BALANCE_ENHANCEMENT
	bool "Ruby aggressive queued-task idle pull"
	depends on MTK_RUBY_SCHED_PREFER && SMP
	default y if MACH_MT6877
	help
	  When ordinary newly-idle balancing finds no task, pull a queued
	  task with an idle preference or a minimum-capacity mismatch from
	  another CPU, subject to the 6.6 migration checks.


config MTK_FRS
	tristate "Mediatek Frame Rate Smoother"
	depends on MTK_FPSGO_V3
	help
	  Support Frame Rate Smoother kernel intergface. It will adjustment
	  target fps by thermal.
	  If you are not sure about this, set n.

config MTK_LOAD_TRACKER
	tristate "CPU Loading Tracking Service"
	depends on CPU_FREQ
	default n
	help
	  MTK_LOAD_TRACKER is the kernel config of CPU Loading Tracking
	  Service designed by MTK, which is a service to get CPU Loading
	  information. User can register callback and config polling
	  duration to get CPU loading.

config MTK_CPU_CTRL_CFP
	bool "MediaTek CPU ceiling relief under high load"
	depends on MTK_LOAD_TRACKER && CPU_FREQ && MACH_MT6877
	help
	  Restore Ruby's ceiling fool proof control. The MT6877 CPU
	  controller raises a requested frequency ceiling by configurable
	  OPP steps while measured load stays high, using cpufreq QoS.

config MTK_LOAD_TRACKER_DEBUG
	tristate "CPU Loading Tracking Service"
	help
	  MTK_LOAD_TRACKER_DEBUG is the kernel debug config of CPU Loading
	  Tracking Service designed by MTK. Use can use it to avoid print
	  trace log on use load.
	  Default it enable on eng, userdebug load.

config MTK_PERF_IOCTL_MAGT
	tristate "Mediatek Adaptive Gaming Technology"
	help
	  Support MAGT analysis performance.
          If you are not sure about this, set n.
```

## drivers/misc/mediatek/sensor/1.0/sensorHub/Kconfig
```kconfig
config CUSTOM_KERNEL_SENSORHUB_1_0
	bool "CUSTOM KERNEL SENSORHUB 1 0 config"
	help
	  Kernel space sensor hub driver.
	  Define project used all sensor hub
	  sensors. The value is combination of sensor hub driver(get data...etc)
	  and sensor hub framework driver(transmit shf info)

#source "drivers/misc/mediatek/sensor/1.0/sensorHub/SCP_sensorHub/Kconfig"
#source "drivers/misc/mediatek/sensor/1.0/sensorHub/SCP_sensorHub_v1/Kconfig"
#source "drivers/misc/mediatek/sensor/1.0/sensorHub/SCP_shf/Kconfig"

source "drivers/misc/mediatek/sensor/1.0/sensorHub/nanohub/Kconfig"
```

## drivers/misc/mediatek/sensor/Kconfig
```kconfig
# SPDX-License-Identifier: GPL-2.0

source "drivers/misc/mediatek/sensor/1.0/Kconfig"
source "drivers/misc/mediatek/sensor/2.0/Kconfig"
```

## drivers/soc/mediatek/Kconfig
```kconfig
# SPDX-License-Identifier: GPL-2.0-only
#
# MediaTek SoC drivers
#
menu "MediaTek SoC drivers"
	depends on ARCH_MEDIATEK || COMPILE_TEST

config MTK_CMDQ
	tristate "MediaTek CMDQ Support"
	depends on ARCH_MEDIATEK || COMPILE_TEST
	select MAILBOX
	select MTK_CMDQ_MBOX
	select MTK_INFRACFG
	help
	  Say yes here to add support for the MediaTek Command Queue (CMDQ)
	  driver. The CMDQ is used to help read/write registers with critical
	  time limitation, such as updating display configuration during the
	  vblank.

config MTK_DEVAPC
	tristate "Mediatek Device APC Support"
	help
	  Say yes here to enable support for Mediatek Device APC driver.
	  This driver is mainly used to handle the violation which catches
	  unexpected transaction.
	  The violation information is logged for further analysis or
	  countermeasures.

config MTK_INFRACFG
	bool "MediaTek INFRACFG Support"
	select REGMAP
	help
	  Say yes here to add support for the MediaTek INFRACFG controller. The
	  INFRACFG controller contains various infrastructure registers not
	  directly associated to any device.

config MTK_PMIC_WRAP
	tristate "MediaTek PMIC Wrapper Support"
	depends on RESET_CONTROLLER
	depends on OF
	select REGMAP
	help
	  Say yes here to add support for MediaTek PMIC Wrapper found
	  on different MediaTek SoCs. The PMIC wrapper is a proprietary
	  hardware to connect the PMIC.

config MTK_REGULATOR_COUPLER
	bool "MediaTek SoC Regulator Coupler" if COMPILE_TEST
	default ARCH_MEDIATEK
	depends on REGULATOR

config MTK_SCPSYS
	bool "MediaTek SCPSYS Support"
	default ARCH_MEDIATEK
	depends on OF
	select REGMAP
	select MTK_INFRACFG
	select PM_GENERIC_DOMAINS if PM
	help
	  Say yes here to add support for the MediaTek SCPSYS power domain
	  driver.

config MTK_SCPSYS_PM_DOMAINS
	bool "MediaTek SCPSYS generic power domain"
	default ARCH_MEDIATEK
	depends on PM
	select PM_GENERIC_DOMAINS
	select REGMAP
	help
	  Say y here to enable power domain support.
	  In order to meet high performance and low power requirements, the System
	  Control Processor System (SCPSYS) has several power management related
	  tasks in the system.

config MTK_MMSYS
	tristate "MediaTek MMSYS Support"
	default ARCH_MEDIATEK
	depends on HAS_IOMEM
	depends on MTK_CMDQ || MTK_CMDQ=n
	help
	  Say yes here to add support for the MediaTek Multimedia
	  Subsystem (MMSYS).

config MTK_SVS
	tristate "MediaTek Smart Voltage Scaling(SVS)"
	depends on NVMEM_MTK_EFUSE && NVMEM
	help
	  The Smart Voltage Scaling(SVS) engine is a piece of hardware
	  which has several controllers(banks) for calculating suitable
	  voltage to different power domains(CPU/GPU/CCI) according to
	  chip process corner, temperatures and other factors. Then DVFS
	  driver could apply SVS bank voltage to PMIC/Buck.

endmenu

config MTK_DVFSRC
	tristate "MediaTek DVFSRC Support"
	depends on ARCH_MEDIATEK
	help
	  Say yes here to add support for the MediaTek DVFSRC (dynamic voltage
	  and frequency scaling resource collector).

config MTK_SCPSYS_BRINGUP
	tristate "MediaTek SCPSYS bring Up Support"
	depends on MTK_SCPSYS
	help
	  Say yes here to support MediaTek SCPSYS power on for early chip
	  bring up.

config MTK_IPI
	tristate "MediaTek IPI Support"
	depends on RPMSG_MTK
	help
	  Say yes here to add support for the MediaTek IPI between tinysys.
	  MTK IPI provides Linux to/from tinysys communication based on
	  rpmsg.

config MTK_MBOX
	tristate "MediaTek Mbox Support"
	help
	  Say yes here to add support for the MediaTek Mbox driver.
	  MTK MBOX provides SRAM-based mailbox channels and interrupt
	  signaling between AP and tinysys.

config MTK_MMDVFS
	tristate "MediaTek MMDVFS Support"
	depends on ARCH_MEDIATEK || COMPILE_TEST
	depends on REGULATOR_MTK_DVFSRC
	help
	  Say yes here to add support for the MediaTek Multimedia DVFS driver.

config MTK_LPM
	bool "MediaTek Low Power Manager"
	depends on ARCH_MEDIATEK
	help
	  Say yes here to add support for the MediaTek Low Power Manager driver.

config MTK_PMQOS
	tristate "MediaTek PMQOS Framework support"
	depends on ARCH_MEDIATEK
	help
	  Say yes here to support the MediaTek PMQOS framework driver.

config MTK_SOCINFO
	tristate "MediaTek SoCInfo Driver"
	select SOC_BUS
	help
	  Say yes here to support the MediaTek SoCInfo driver, exposing SoC
	  information to userspace.

source "drivers/soc/mediatek/devapc/Kconfig"

source "drivers/soc/mediatek/devmpu/Kconfig"
```

## drivers/staging/android/Kconfig
```kconfig
# SPDX-License-Identifier: GPL-2.0
menu "Android"

config ASHMEM
	bool "Enable the Anonymous Shared Memory Subsystem"
	depends on SHMEM
	help
	  The ashmem subsystem is a new shared memory allocator, similar to
	  POSIX SHM but with different behavior and sporting a simpler
	  file-based API.

	  It is, in theory, a good memory allocator for low-memory devices,
	  because it can discard shared memory units when under memory pressure.

endmenu

config MTK_ION_COMPAT
	bool "MediaTek legacy ION DMA-BUF import compatibility"
	depends on 64BIT
	depends on DMA_SHARED_BUFFER
	depends on DMABUF_HEAPS_SYSTEM=y
	depends on IOMMU_API
	depends on MTK_IOMMU
	depends on !MTK_PSEUDO_M4U
	depends on OF
	depends on PM
	help
	  Provide the legacy /dev/ion IMPORT, SHARE, FREE and MediaTek
	  GET_IOVA ioctls needed by older MediaTek multimedia userspace while
	  keeping DMA-BUF heaps as the allocator. This does not provide legacy
	  ION allocation heaps.
```
